## buildroot/package/Config.in
```kconfig
menu "AAPIWP packages"

source "$BR2_EXTERNAL_AAPIWP_PATH/package/aapiwp/Config.in"

endmenu
```

## buildroot/package/aapiwp/Config.in
```kconfig
config BR2_PACKAGE_AAPIWP
	bool "aapiwp"
	depends on BR2_INSTALL_LIBSTDCPP
	depends on BR2_TOOLCHAIN_HAS_THREADS
	select BR2_PACKAGE_BOOST
	select BR2_PACKAGE_DBUS_CXX
	select BR2_PACKAGE_LIBUSB
	select BR2_PACKAGE_PROTOBUF
	select BR2_PACKAGE_ZLIB
	help
	  Android Auto (Raspberry) Pi Wireless Proxy Daemon.
```
